## config/west.yml
```yaml
manifest:
  remotes:
    - name: zmkfirmware
      url-base: https://github.com/zmkfirmware
    - name: caksoylar
      url-base: https://github.com/caksoylar
    - name: badjeff
      url-base: https://github.com/badjeff/
    - name: efogdev
      url-base: https://github.com/efogdev
    - name: nuovotaka
      url-base: https://github.com/nuovotaka
    - name: carrefinho                           
      url-base: https://github.com/carrefinho 
  projects:
    - name: zmk
      remote: zmkfirmware
      revision: main
      import: app/west.yml
    - name: zmk-rgbled-widget
      remote: caksoylar
      revision: main
    - name: zmk-pmw3610-driver
      remote: efogdev
      revision: zephyr-4.1
    - name: zmk-input-processor-report-rate-limit
      remote: badjeff
      revision: main
    - name: zmk-pointing-acceleration-alpha
      remote: nuovotaka
      revision: main
    - name: prospector-zmk-module                 # <--- and these
      remote: carrefinho                          # <---
      revision: feat/new-status-screens           # <---
  self:
    path: config
```

## drivers/sensor/apds9960c/Kconfig
```kconfig
# Clone-tolerant APDS9960 driver.
# Based on Zephyr's drivers/sensor/apds9960/Kconfig, renamed to the APDS9960C
# namespace so it can coexist with (and replace) the in-tree driver.
# SPDX-License-Identifier: Apache-2.0

config APDS9960C
	bool "APDS9960 ambient light / proximity sensor (clone-tolerant)"
	default y
	depends on DT_HAS_ZMK_APDS9960_ENABLED
	select I2C
	select SENSOR
	help
	  Patched APDS9960 driver that also accepts clone chips reporting
	  device id 0x9f (the stock CONFIG_APDS9960 driver only accepts 0xab
	  and 0x9c). Binds "zmk,apds9960" nodes. Retarget an avago,apds9960
	  node to this compatible via an overlay to use this driver; the
	  in-tree avago,apds9960 driver then matches no nodes and stays inert.

if APDS9960C

choice
	prompt "Trigger mode"
	default APDS9960C_TRIGGER_NONE
	help
	  Specify the type of triggering used by the driver. Default is polled
	  (no interrupt), which does not require the sensor int-gpios line.

config APDS9960C_TRIGGER_NONE
	bool "No trigger"

endchoice

config APDS9960C_TRIGGER
	bool

config APDS9960C_ENABLE_ALS
	bool "Ambient Light Sense"
	default y

choice
	prompt "Proximity Gain"
	default APDS9960C_PGAIN_4X

config APDS9960C_PGAIN_1X
	bool "1x"

config APDS9960C_PGAIN_2X
	bool "2x"

config APDS9960C_PGAIN_4X
	bool "4x"

config APDS9960C_PGAIN_8X
	bool "8x"

endchoice

choice
	prompt "ALS and Color Gain"
	default APDS9960C_AGAIN_4X

config APDS9960C_AGAIN_1X
	bool "1x"

config APDS9960C_AGAIN_4X
	bool "4x"

config APDS9960C_AGAIN_16X
	bool "16x"

config APDS9960C_AGAIN_64X
	bool "64x"

endchoice

choice
	prompt "Proximity Pulse Length"
	default APDS9960C_PPULSE_LENGTH_8US

config APDS9960C_PPULSE_LENGTH_4US
	bool "4us"

config APDS9960C_PPULSE_LENGTH_8US
	bool "8us"

config APDS9960C_PPULSE_LENGTH_16US
	bool "16us"

config APDS9960C_PPULSE_LENGTH_32US
	bool "32us"

endchoice

choice
	prompt "Proximity LED boost current"
	default APDS9960C_PLED_BOOST_100PCT

config APDS9960C_PLED_BOOST_300PCT
	bool "300%"

config APDS9960C_PLED_BOOST_200PCT
	bool "200%"

config APDS9960C_PLED_BOOST_150PCT
	bool "150%"

config APDS9960C_PLED_BOOST_100PCT
	bool "100%"

endchoice

config APDS9960C_PPULSE_COUNT
	int "Proximity Pulse Count"
	range 1 64
	default 8

endif # APDS9960C
```
